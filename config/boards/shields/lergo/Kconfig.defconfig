## config/boards/shields/lergo/Kconfig.defconfig
```kconfig
if SHIELD_LERGO_LEFT

config ZMK_KEYBOARD_NAME
    default "lergo"

config ZMK_SPLIT_BLE_ROLE_CENTRAL
    default y

endif

if SHIELD_LERGO_LEFT || SHIELD_LERGO_RIGHT

config ZMK_SPLIT
    default y

endif
```

## config/boards/shields/lergo/Kconfig.shield
```kconfig
# Copyright (c) 2020 The ZMK Contributors
# SPDX-License-Identifier: MIT

config SHIELD_LERGO_LEFT
    def_bool $(shields_list_contains,lergo_left)

config SHIELD_LERGO_RIGHT
    def_bool $(shields_list_contains,lergo_right)
```
